## Kconfig
```kconfig
# This is a basic Kconfig file to enable the new module.
# You can add more configuration options here if needed.

DT_COMPAT_ZMK_BEHAVIOR_MAGIC_KEY := "zmk,behavior-magic-key"

config ZMK_BEHAVIOR_MAGIC_KEY
    bool "Enable Magic Key behavior"
    default $(dt_compat_enabled,$(DT_COMPAT_ZMK_BEHAVIOR_MAGIC_KEY))
```

## dts/bindings/zmk,behavior-magic-key.yaml
```yaml
description: |
  A special custom behavior that performs a predefined action when pressed.

compatible: "zmk,behavior-magic-key"
```
